## config/boards/shields/corne/Kconfig.shield
```kconfig
# Copyright (c) 2020 Pete Johanson
# SPDX-License-Identifier: MIT

config SHIELD_CORNEPLUS_LEFT
	def_bool $(shields_list_contains,corneplus_left)

config SHIELD_CORNEPLUS_RIGHT
	def_bool $(shields_list_contains,corneplus_right)
```

## config/boards/shields/corneplus/Kconfig.defconfig
```kconfig
if SHIELD_CORNEPLUS_LEFT

config ZMK_KEYBOARD_NAME
    default "corneplus"

config ZMK_SPLIT_ROLE_CENTRAL
    default y

endif

if SHIELD_CORNEPLUS_LEFT || SHIELD_CORNEPLUS_RIGHT

config ZMK_SPLIT
    default y

endif
```

## config/boards/shields/corneplus/Kconfig.shield
```kconfig
config SHIELD_CORNEPLUS_LEFT
    def_bool $(shields_list_contains,corneplus_right)

config SHIELD_CORNEPLUS_RIGHT
    def_bool $(shields_list_contains,corneplus_right)
```
